## build/Kconfig/Kconfig.shield
```kconfig
osource "c:/users/mexlinkinshanghai/desktop/workinfeb/nrfreal/bt-fund-main/bt-fund-main/v2.9.0-v2.7.0/l2/l2_e3_sol/boards/shields/*/Kconfig.shield"
osource "C:/ncs/v2.7.0/nrf/boards/shields/*/Kconfig.shield"
```

## build_1/Kconfig/Kconfig.shield
```kconfig
osource "c:/users/mexlinkinshanghai/desktop/workinfeb_pc/nrf_dev_find_your_heart/l2_e3_sol/boards/shields/*/Kconfig.shield"
osource "C:/ncs/v2.7.0/nrf/boards/shields/*/Kconfig.shield"
```
